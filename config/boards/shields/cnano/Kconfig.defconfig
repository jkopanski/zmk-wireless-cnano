## config/boards/shields/cnano/Kconfig.defconfig
```kconfig
if SHIELD_CNANO_RIGHT

config ZMK_KEYBOARD_NAME
    default "cnano"

config ZMK_SPLIT_ROLE_CENTRAL
    default y

endif


if SHIELD_CNANO_LEFT || SHIELD_CNANO_RIGHT

config ZMK_SPLIT
    default y

endif
```
